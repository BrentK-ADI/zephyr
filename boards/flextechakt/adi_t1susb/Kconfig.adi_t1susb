## boards/flextechakt/adi_t1susb/Kconfig.adi_t1susb
```kconfig
# FlextechAKT ADI-T1SUSB board configuration

# Copyright (c) 2026 Analog Devices, Inc.
# SPDX-License-Identifier: Apache-2.0

config BOARD_ADI_T1SUSB
	select SOC_MAX32690_M4 if BOARD_ADI_T1SUSB_MAX32690_M4
```

## boards/flextechakt/adi_t1susb/Kconfig.defconfig
```kconfig
# Copyright (c) 2026 Analog Devices, Inc.
# SPDX-License-Identifier: Apache-2.0

if BOARD_ADI_T1SUSB

config SPI_MAX32_DMA
	default y

if ETH_ADIN1140

configdefault NET_IF_MAX_IPV4_COUNT
	default 2

endif # ETH_ADIN1140

configdefault ETH_DRIVER
	default y

endif # BOARD_ADI_T1SUSB
```

## boards/flextechakt/adi_t1susb/board.yml
```yaml
# Copyright (c) 2026 Analog Devices, Inc.
# SPDX-License-Identifier: Apache-2.0

board:
  name: adi_t1susb
  full_name: Flextech AKT ADI-T1SUSB Development Board
  vendor: flextechakt
  socs:
    - name: max32690
```
